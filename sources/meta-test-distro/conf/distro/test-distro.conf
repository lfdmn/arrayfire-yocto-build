## sources/meta-test-distro/conf/distro/test-distro.conf
```bitbake
include conf/distro/poky.conf

DISTRO = "test-distro"
DISTRO_NAME = "test-distro"
DISTRO_CODENAME = "zeus"
DISTRO_VERSION = "1.0.0"
SDK_VERSION := "${DISTRO_VERSION}"

SDK_MACHINE = "${@d.getVar('SDKMACHINE', True) or '${SDK_ARCH}'}"
SDK_NAME = "${IMAGE_BASENAME}-${SDK_VERSION}-${DISTRO_CODENAME}-${SDK_MACHINE}"
TOOLCHAIN_OUTPUTNAME = "${SDK_NAME}-${MACHINE}"
BUILDCFG_VARS += "SDKMACHINE"
SDKPATH = "/opt/test-${SDK_VERSION}-${DISTRO_CODENAME}-${MACHINE}"

MAINTAINER = "Damien LEFEVRE <lefevre.da@gmail.com>"

SANITY_TESTED_DISTROS += " \
            ubuntu 11.04 \n \
            ubuntu-15.10 \n \
            linuxMint-14 \n \
            linuxmint-16 \n \
            linuxmint-17.1 \n \
            linuxmint-18.1 \n \
            linuxmint-18.2 \n \
            linuxmint-18.3 \n \
            linuxmint-19.2 \n \
            linuxmint-19.3 \n \
            "

SYSVINIT_ENABLED_GETTYS = ""

DISTRO_FEATURES_DEFAULT_remove = "irda pcmcia pci 3g nfc zeroconf x11"
DISTRO_FEATURES_BACKFILL_CONSIDERED = "pulseaudio sysvinit"

DISTRO_FEATURES_FILTER_NATIVESDK_append = " wayland"

FONTCONFIG_CACHE_DIR = "${libdir}/fontconfig/cache"

# use GStreamer 1.0, optionally change to "gstreamer010" to use GStreamer 0.10
DISTRO_FEATURES += "gstreamer systemd pam"

#INIT_MANAGER = "systemd"
VIRTUAL-RUNTIME_init_manager = "systemd"
VIRTUAL-RUNTIME_initscripts = ""
PREFERRED_PROVIDER_udev ?= "systemd"
PREFERRED_PROVIDER_udev-utils ?= "systemd"

PREFERRED_PROVIDER_jpeg ?= "libjpeg-turbo"
PREFERRED_PROVIDER_jpeg-native ?= "libjpeg-turbo-native"

# IMAGE_FSTYPES = "conf"
IMAGE_CLASSES += "image_types_tegra"

LICENSE_CREATE_PACKAGE = "1"
COPY_LIC_MANIFEST = "1"

include conf/distro/include/${MACHINE}.conf

GCCVERSION_aarch64 = "7.%"
DEBUG_PREFIX_MAP_remove = "-fmacro-prefix-map=${WORKDIR}=/usr/src/debug/${PN}/${EXTENDPE}${PV}-${PR}"
DEBUG_PREFIX_MAP_remove_aarch64 = "-fmacro-prefix-map=${WORKDIR}=/usr/src/debug/${PN}/${EXTENDPE}${PV}-${PR}"


CUDA_BINARIES_NATIVE ?= "cuda-binaries-ubuntu1804-native"

VOLATILE_LOG_DIR = "no"

IMG_STRIP_NAMES ??= ""

include conf/machine/${MACHINE}-extra.conf
```

## sources/meta-test-distro/conf/layer.conf
```bitbake
# We have a conf and classes directory, add to BBPATH
BBPATH .= ":${LAYERDIR}"

# We have recipes-* directories, add to BBFILES
BBFILES += " \
    ${LAYERDIR}/recipes-*/*.bb \
    ${LAYERDIR}/recipes-*/*.bbappend \
    ${LAYERDIR}/recipes-*/*/*.bb \
    ${LAYERDIR}/recipes-*/*/*.bbappend \
"

BBFILE_COLLECTIONS += "test-distro"
BBFILE_PATTERN_test-distro = "^${LAYERDIR}/"
BBFILE_PRIORITY_test-distro = "100"

LAYERDEPENDS_test-distro = "core"

LAYERSERIES_CORENAMES = "zeus"

# This should only be incremented on significant changes that will
# cause compatibility issues with other layers
LAYERVERSION_test-distro = "11"
LAYERSERIES_COMPAT_test-distro = "zeus"

BBFILES_DYNAMIC += " \
    tegra:${LAYERDIR}/dynamic-layers/tegra/recipes*/*/*.bb \
    tegra:${LAYERDIR}/dynamic-layers/tegra/recipes*/*/*.bbappend \
"
```

## sources/meta-test-distro/conf/local.conf.sample
```bitbake
BB_NUMBER_THREADS ?= "${@oe.utils.cpu_count()}"
PARALLEL_MAKE ?= "-j ${@oe.utils.cpu_count()}"
MACHINE ??= "qemux86"
MACHINE_HOSTNAME ?= "test-${MACHINE}"
DL_DIR ?= "${TOPDIR}/../downloads"
SSTATE_DIR ?= "${TOPDIR}/../sstate-cache"
TMPDIR = "${TOPDIR}/tmp"
DISTRO = "test-distro"
PACKAGE_CLASSES ?= "package_ipk"
EXTRA_IMAGE_FEATURES = "debug-tweaks"
USER_CLASSES ?= "buildstats image-mklibs"
PATCHRESOLVE = "noop"

BB_DISKMON_DIRS = "\
    STOPTASKS,${TMPDIR},1G,100K \
    STOPTASKS,${DL_DIR},1G,100K \
    STOPTASKS,${SSTATE_DIR},1G,100K \
    ABORT,${TMPDIR},100M,1K \
    ABORT,${DL_DIR},100M,1K \
    ABORT,${SSTATE_DIR},100M,1K" 

CONF_VERSION = "1"

INHERIT += "image-buildinfo"

include conf/distro/include/${MACHINE}.pre.inc
NVIDIA_DEVNET_MIRROR = "/home/$USER/Downloads/nvidia/sdkm_downloads"

# Ubuntu 16.04 base machines, uncomment this line
#CUDA_BINARIES_NATIVE = "cuda-binaries-ubuntu1604-native"
```
